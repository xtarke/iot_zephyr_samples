## CMakeLists.txt
```
#
# Copyright (c) 2022 Nordic Semiconductor ASA
#
# SPDX-License-Identifier: LicenseRef-Nordic-5-Clause
#

cmake_minimum_required(VERSION 3.20.0)

find_package(Zephyr REQUIRED HINTS $ENV{ZEPHYR_BASE})
project(mqtt)

target_sources(app PRIVATE src/main.c src/wifi.c src/mqtt_client.c)
```

## Kconfig
```
# Copyright (c) 2024 Analog Devices, Inc.
# Modified by Renan Augusto Starke
# SPDX-License-Identifier: Apache-2.0

mainmenu "Secure MQTT Sensor Actuator Sample Application"

config NET_SAMPLE_MQTT_BROKER_HOSTNAME
	string "Hostname of MQTT broker"
	default "test.mosquitto.org"
	help
	  MQTT broker's hostname or IP address.

config NET_SAMPLE_MQTT_BROKER_PORT
	string "MQTT Broker Connection Port"
	default "1883"
	help
	  Port through which the application should connect to the MQTT broker.
	  Secure MQTT uses port 8883.

config NET_SAMPLE_MQTT_PUB_TOPIC
	string "The MQTT topic the application should publish data to"
	default "zephyr_juca_sample/sensor"

config NET_SAMPLE_MQTT_SUB_TOPIC_CMD
	string "The MQTT topic the application will receive commands on"
	default "zephyr_juca_sample/command"

config NET_SAMPLE_MQTT_PUBLISH_INTERVAL
	int "Interval between MQTT publishes (in seconds)"
	default 10
	help
	  This config determines the frequency at which MQTT publishes occur.

choice NET_SAMPLE_MQTT_QOS
	prompt "Quality of Service level used for MQTT publish and subscribe"
	default NET_SAMPLE_MQTT_QOS_1_AT_LEAST_ONCE

config NET_SAMPLE_MQTT_QOS_0_AT_MOST_ONCE
	bool "QoS 0 / At most once delivery"
	help
	  No acknowledgment needed for published message.

config NET_SAMPLE_MQTT_QOS_1_AT_LEAST_ONCE
	bool "QoS 1 / At least once delivery"
	help
	  If acknowledgment expected for published message, duplicate messages permitted.

config NET_SAMPLE_MQTT_QOS_2_EXACTLY_ONCE
	bool "QoS 2 / Exactly once delivery"
	help
	   Acknowledgment expected and message shall be published only once.

endchoice

config NET_SAMPLE_MQTT_PAYLOAD_SIZE
	int "Size of MQTT payload in bytes"
	default 128

source "Kconfig.zephyr"
```

## prj.conf
```kconfig
# Logging, minimum without colors
CONFIG_LOG=y
CONFIG_LOG_MODE_MINIMAL=y

# GPIO Driver (already activated by minimum config)
CONFIG_GPIO=y

# # Wi-Fi
# # Enable the Wi-Fi relevant configurations
CONFIG_WIFI=y
# Disable Zephyr WPA since there is an external chip
# CONFIG_WIFI_NM_WPA_SUPPLICANT=n

# # Configure the Wi-Fi credentials
CONFIG_WIFI_CREDENTIALS=y
CONFIG_WIFI_CREDENTIALS_STATIC=y
CONFIG_WIFI_CREDENTIALS_STATIC_SSID="iot-juca"
CONFIG_WIFI_CREDENTIALS_STATIC_PASSWORD="gsypt88651"

# Enable the Network Management relevant configurations
# CONFIG_NET_MGMT=y
CONFIG_NET_MGMT_EVENT=y
#CONFIG_NET_MGMT_EVENT_INFO=y
CONFIG_NET_MGMT_EVENT_QUEUE_TIMEOUT=5000
CONFIG_NET_MGMT_EVENT_QUEUE_SIZE=16
CONFIG_NET_L2_WIFI_MGMT=y
# CONFIG_WIFI_LOG_LEVEL_DBG=y

# # Enable the Connection Manager 
CONFIG_NET_CONNECTION_MANAGER=y
# CONFIG_NET_CONNECTION_MANAGER_MONITOR_STACK_SIZE=5200

# # System settings
# CONFIG_NEWLIB_LIBC=y
# CONFIG_NEWLIB_LIBC_NANO=n

# # Networking
CONFIG_NETWORKING=y
CONFIG_TEST_RANDOM_GENERATOR=y
CONFIG_NET_L2_ETHERNET=y
CONFIG_NET_IPV4=y
CONFIG_NET_IPV6=n
CONFIG_NET_DHCPV4=y
CONFIG_NET_TCP=y
# Disable network shell
CONFIG_NET_SHELL=n
# Print network debug
CONFIG_NET_LOG=y

# Sockets
CONFIG_NET_SOCKETS=y
CONFIG_ZVFS_POLL_MAX=4

# # Memory
# CONFIG_SYSTEM_WORKQUEUE_STACK_SIZE=4096
CONFIG_MAIN_STACK_SIZE=5200
CONFIG_NET_TX_STACK_SIZE=2048
CONFIG_NET_RX_STACK_SIZE=2048

CONFIG_NET_MAX_CONTEXTS=16
CONFIG_NET_PKT_RX_COUNT=16
CONFIG_NET_PKT_TX_COUNT=16
CONFIG_NET_BUF_RX_COUNT=32
CONFIG_NET_BUF_TX_COUNT=32

# DNS
CONFIG_DNS_RESOLVER=y
CONFIG_DNS_RESOLVER_ADDITIONAL_BUF_CTR=2
CONFIG_DNS_RESOLVER_MAX_SERVERS=1
CONFIG_DNS_SERVER_IP_ADDRESSES=n
CONFIG_DNS_SERVER1="8.8.8.8"
CONFIG_NET_SOCKETS_DNS_TIMEOUT=5000
CONFIG_DNS_RESOLVER_LOG_LEVEL_DBG=n

# MQTT
CONFIG_POSIX_API=y
CONFIG_MQTT_LIB=y
```

## src/main.c
```c
/**
 * @file main.c
 * @brief Main application entry point for the Zephyr Wi-Fi and MQTT sample.
 *
 * Initializes Wi-Fi connectivity, configures the MQTT client, schedules periodic
 * message publishing via the system work queue, and processes incoming MQTT events.
 */

/* C includes */
#include <errno.h>
#include <stddef.h>
#include <string.h>
#include <stdio.h>

/* Zephyr includes */
#include <zephyr/kernel.h>
#include <zephyr/types.h>
#include <zephyr/logging/log.h>

/* Wifi header files */
#include <zephyr/net/net_mgmt.h>
#include <zephyr/net/wifi_mgmt.h>
#include <zephyr/net/wifi_credentials.h>

/* MQTT includes */
#include <zephyr/net/mqtt.h>

/* Local includes */
#include "wifi.h"
#include "mqtt_client.h"

/* MQTT client struct */
static struct mqtt_client client_ctx;

/* MQTT publish work item */
struct k_work_delayable mqtt_publish_work;


LOG_MODULE_REGISTER(main, LOG_LEVEL_INF);

/**
 * @brief Work handler for periodic MQTT publishing.
 *
 * Executed by the Zephyr system work queue. If the MQTT client is connected
 * (@ref mqtt_connected is `true`), publishes a `"Hello!"` message to the topic
 * defined by `CONFIG_NET_SAMPLE_MQTT_PUB_TOPIC` and reschedules itself according
 * to `CONFIG_NET_SAMPLE_MQTT_PUBLISH_INTERVAL`. Otherwise, cancels the delayable work.
 *
 * @param[in] work Pointer to the @c k_work structure associated with @ref mqtt_publish_work.
 */
static void publish_work_handler(struct k_work *work)
{
	int rc;

	if (mqtt_connected) {
		rc = app_mqtt_publish(&client_ctx, CONFIG_NET_SAMPLE_MQTT_PUB_TOPIC, "Hello!");
		if (rc != 0) {
			LOG_INF("MQTT Publish failed [%d]", rc);
		}
		k_work_reschedule(&mqtt_publish_work,
					K_SECONDS(CONFIG_NET_SAMPLE_MQTT_PUBLISH_INTERVAL));
	} else {
		k_work_cancel_delayable(&mqtt_publish_work);
	}
}

/**
 * @brief Callback function invoked when an MQTT message is received.
 *
 * Logs the topic and payload data of incoming messages on subscribed topics.
 * Registered via @ref register_MQTT_sub_callback.
 *
 * @param[in] topic        Null-terminated string containing the topic name.
 * @param[in] payload_data Pointer to the received payload buffer.
 */
void mqtt_event(const char *topic, uint8_t *payload_data) {
    
	LOG_INF("On MQTT msg callback!");
	LOG_INF("Topic: %s.", topic);
	LOG_INF("Paylod: %s.", payload_data);
}


/**
 * @brief Main application entry point.
 *
 * Establishes Wi-Fi connectivity via @ref setup_wifi, initializes the MQTT client
 * context, initializes the periodic publish work item, and registers the incoming
 * message callback. Enters a loop that connects to the MQTT
 * broker, starts periodic publishing, and runs the MQTT event loop.
 *
 * @return 0 on normal completion, or a negative error code if MQTT initialization fails.
 */
int main(void)
{
	int rc;
	
	LOG_INF("MQTT sample.");

	/* Try to connect to Wifi. Ths function does not return
	 * until a wifi connection is stablished.
	*/
	setup_wifi();

	rc = app_mqtt_init(&client_ctx);
	if (rc != 0) {
		LOG_ERR("MQTT Init failed [%d]", rc);
		return rc;
	}

	k_work_init_delayable(&mqtt_publish_work, publish_work_handler);


	register_MQTT_sub_callback(mqtt_event);

	while (1) {
		/* Block until MQTT connection is up */
		app_mqtt_connect(&client_ctx);
		

		/* We are now connected, begin queueing periodic MQTT publishes */
		k_work_reschedule(&mqtt_publish_work,
					K_SECONDS(CONFIG_NET_SAMPLE_MQTT_PUBLISH_INTERVAL));

		/* Handle MQTT inputs and connection */
		app_mqtt_run(&client_ctx);
	}


	return 0;
}
```

## src/mqtt_client.c
```c
/*
 * Copyright (c) 2024 Analog Devices, Inc.
 *
 * Modified by Renan Augusto Starke, 2026.
 *
 * SPDX-License-Identifier: Apache-2.0
 */

#include <zephyr/logging/log.h>
LOG_MODULE_REGISTER(app_mqtt, LOG_LEVEL_DBG);

#include <zephyr/data/json.h>
#include <zephyr/kernel.h>
#include <zephyr/net/mqtt.h>
#include <zephyr/posix/arpa/inet.h>
#include <zephyr/posix/netdb.h>
#include <zephyr/posix/poll.h>
#include <zephyr/posix/sys/socket.h>
#include <zephyr/random/random.h>

#include "mqtt_client.h"

/* Buffers for MQTT client */
static uint8_t rx_buffer[CONFIG_NET_SAMPLE_MQTT_PAYLOAD_SIZE];
static uint8_t tx_buffer[CONFIG_NET_SAMPLE_MQTT_PAYLOAD_SIZE];

/* MQTT payload buffer */
static uint8_t payload_buf[CONFIG_NET_SAMPLE_MQTT_PAYLOAD_SIZE];

/* MQTT broker details */
static struct sockaddr_storage broker;


static MQTT_msg_received_callback on_msg_callback = NULL;


/* Socket descriptor */
static struct pollfd fds[1];
static int nfds;

/* MQTT connectivity status flag */
bool mqtt_connected;

/* MQTT client ID buffer */
static uint8_t client_id[50];

#if defined(CONFIG_MQTT_LIB_TLS)
#include "tls_config/cert.h"

/* This should match the CN field in the server's CA cert */
#define TLS_SNI_HOSTNAME	CONFIG_NET_SAMPLE_MQTT_BROKER_HOSTNAME
#define APP_CA_CERT_TAG		1

static const sec_tag_t m_sec_tags[] = {
	APP_CA_CERT_TAG,
};

/** Register CA certificate for TLS */
static int tls_init(void)
{
	int rc;

	rc = tls_credential_add(APP_CA_CERT_TAG, TLS_CREDENTIAL_CA_CERTIFICATE,
				 ca_certificate, sizeof(ca_certificate));
	if (rc < 0) {
		LOG_ERR("Failed to register public certificate: %d", rc);
		return rc;
	}

	return rc;
}
#endif

static void prepare_fds(struct mqtt_client *client)
{
	if (client->transport.type == MQTT_TRANSPORT_NON_SECURE) {
		fds[0].fd = client->transport.tcp.sock;
	}
#if defined(CONFIG_MQTT_LIB_TLS)
	else if (client->transport.type == MQTT_TRANSPORT_SECURE) {
		fds[0].fd = client->transport.tls.sock;
	}
#endif

	fds[0].events = POLLIN;
	nfds = 1;
}

static void clear_fds(void)
{
	nfds = 0;
}

/** Initialise the MQTT client ID as the board name with random hex postfix */
static void init_mqtt_client_id(void)
{
	snprintk(client_id, sizeof(client_id), CONFIG_BOARD"_%x", (uint8_t)sys_rand32_get());
}

static inline void on_mqtt_connect(void)
{
	mqtt_connected = true;
	
	/* Turn on led if necessary */
	//device_write_led(LED_NET, LED_ON);

	LOG_INF("Connected to MQTT broker!");
	LOG_INF("Hostname: %s", CONFIG_NET_SAMPLE_MQTT_BROKER_HOSTNAME);
	LOG_INF("Client ID: %s", client_id);
	LOG_INF("Port: %s", CONFIG_NET_SAMPLE_MQTT_BROKER_PORT);
	LOG_INF("TLS: %s",
		IS_ENABLED(CONFIG_MQTT_LIB_TLS) ? "Enabled" : "Disabled");
}

static inline void on_mqtt_disconnect(void)
{
	mqtt_connected = false;
	clear_fds();
	

	/* Turn off LED if necessary */
	//device_write_led(LED_NET, LED_OFF);
	
	
	LOG_INF("Disconnected from MQTT broker");
}

/** Called when an MQTT payload is received.
 *  Reads the payload and calls the commands
 *  handler if a payloads is received on the
 *  command topic
 */
static void on_mqtt_publish(struct mqtt_client *const client, const struct mqtt_evt *evt)
{
	int rc;
	uint8_t payload[CONFIG_NET_SAMPLE_MQTT_PAYLOAD_SIZE];

	rc = mqtt_read_publish_payload(client, payload,
					CONFIG_NET_SAMPLE_MQTT_PAYLOAD_SIZE);
	if (rc < 0) {
		LOG_ERR("Failed to read received MQTT payload [%d]", rc);
		return;
	}
	/* Place null terminator at end of payload buffer */
	payload[rc] = '\0';

	LOG_INF("MQTT payload received!");
	LOG_INF("topic: '%s', payload: %s",
		evt->param.publish.message.topic.topic.utf8, payload);

	/* If the topic is a command, call the command handler  */
	if (strcmp(evt->param.publish.message.topic.topic.utf8,
			CONFIG_NET_SAMPLE_MQTT_SUB_TOPIC_CMD) == 0) {
		
			if (on_msg_callback != NULL)
				on_msg_callback(evt->param.publish.message.topic.topic.utf8, payload);
			else
				LOG_INF("MQTT subscribe callback not registered.");
		
	}
}

/** Handler for asynchronous MQTT events */
static void mqtt_event_handler(struct mqtt_client *const client, const struct mqtt_evt *evt)
{
	switch (evt->type) {
	case MQTT_EVT_CONNACK:
		if (evt->result != 0) {
			LOG_ERR("MQTT Event Connect failed [%d]", evt->result);
			break;
		}
		on_mqtt_connect();
		break;

	case MQTT_EVT_DISCONNECT:
		on_mqtt_disconnect();
		break;

	case MQTT_EVT_PINGRESP:
		LOG_INF("PINGRESP packet");
		break;

	case MQTT_EVT_PUBACK:
		if (evt->result != 0) {
			LOG_ERR("MQTT PUBACK error [%d]", evt->result);
			break;
		}

		LOG_INF("PUBACK packet ID: %u", evt->param.puback.message_id);
		break;

	case MQTT_EVT_PUBREC:
		if (evt->result != 0) {
			LOG_ERR("MQTT PUBREC error [%d]", evt->result);
			break;
		}

		LOG_INF("PUBREC packet ID: %u", evt->param.pubrec.message_id);

		const struct mqtt_pubrel_param rel_param = {
			.message_id = evt->param.pubrec.message_id
		};

		mqtt_publish_qos2_release(client, &rel_param);
		break;

	case MQTT_EVT_PUBREL:
		if (evt->result != 0) {
			LOG_ERR("MQTT PUBREL error [%d]", evt->result);
			break;
		}

		LOG_INF("PUBREL packet ID: %u", evt->param.pubrel.message_id);

		const struct mqtt_pubcomp_param rec_param = {
			.message_id = evt->param.pubrel.message_id
		};

		mqtt_publish_qos2_complete(client, &rec_param);
		break;

	case MQTT_EVT_PUBCOMP:
		if (evt->result != 0) {
			LOG_ERR("MQTT PUBCOMP error %d", evt->result);
			break;
		}

		LOG_INF("PUBCOMP packet ID: %u", evt->param.pubcomp.message_id);
		break;

	case MQTT_EVT_SUBACK:
		if (evt->result == MQTT_SUBACK_FAILURE) {
			LOG_ERR("MQTT SUBACK error [%d]", evt->result);
			break;
		}

		LOG_INF("SUBACK packet ID: %d", evt->param.suback.message_id);
		break;

	case MQTT_EVT_PUBLISH:
		const struct mqtt_publish_param *p = &evt->param.publish;

		if (p->message.topic.qos == MQTT_QOS_1_AT_LEAST_ONCE) {
			const struct mqtt_puback_param ack_param = {
				.message_id = p->message_id
			};
			mqtt_publish_qos1_ack(client, &ack_param);
		} else if (p->message.topic.qos == MQTT_QOS_2_EXACTLY_ONCE) {
			const struct mqtt_pubrec_param rec_param = {
				.message_id = p->message_id
			};
			mqtt_publish_qos2_receive(client, &rec_param);
		}

		on_mqtt_publish(client, evt);

	default:
		break;
	}
}

/** Poll the MQTT socket for received data */
static int poll_mqtt_socket(struct mqtt_client *client, int timeout)
{
	int rc;

	prepare_fds(client);

	if (nfds <= 0) {
		return -EINVAL;
	}

	rc = poll(fds, nfds, timeout);
	if (rc < 0) {
		LOG_ERR("Socket poll error [%d]", rc);
	}

	return rc;
}

int app_mqtt_publish(struct mqtt_client *client,
					const char *topic, uint8_t *payload_data)
{
	int rc;
	struct mqtt_publish_param param;
	struct mqtt_binstr payload;
	static uint16_t msg_id = 1;
	struct mqtt_topic fmt_topic = {
		.topic = {
			.utf8 = topic,
			.size = strlen(topic)
		},
		.qos = IS_ENABLED(CONFIG_NET_SAMPLE_MQTT_QOS_0_AT_MOST_ONCE) ? 0 :
			(IS_ENABLED(CONFIG_NET_SAMPLE_MQTT_QOS_1_AT_LEAST_ONCE) ? 1 : 2)
	};

	payload.data = payload_data;
	payload.len = strlen(payload_data);

	param.message.topic = fmt_topic;
	param.message.payload = payload;
	param.message_id = msg_id++;
	param.dup_flag = 0;
	param.retain_flag = 0;

	rc = mqtt_publish(client, &param);
	if (rc != 0) {
		LOG_ERR("MQTT Publish failed [%d]", rc);
	}

	LOG_INF("Published %s to topic '%s', QoS %d",
			payload.data,
			param.message.topic.topic.utf8,
			param.message.topic.qos);

	return rc;
}

int app_mqtt_subscribe(struct mqtt_client *client)
{
	int rc;
	struct mqtt_topic sub_topics[] = {
		{
			.topic = {
				.utf8 = CONFIG_NET_SAMPLE_MQTT_SUB_TOPIC_CMD,
				.size = strlen(sub_topics->topic.utf8)
			},
			.qos = IS_ENABLED(CONFIG_NET_SAMPLE_MQTT_QOS_0_AT_MOST_ONCE) ? 0 :
				(IS_ENABLED(CONFIG_NET_SAMPLE_MQTT_QOS_1_AT_LEAST_ONCE) ? 1 : 2)
		}
	};
	const struct mqtt_subscription_list sub_list = {
		.list = sub_topics,
		.list_count = ARRAY_SIZE(sub_topics),
		.message_id = 5841u
	};

	LOG_INF("Subscribing to %d topic(s)", sub_list.list_count);

	rc = mqtt_subscribe(client, &sub_list);
	if (rc != 0) {
		LOG_ERR("MQTT Subscribe failed [%d]", rc);
	}

	return rc;
}


void register_MQTT_sub_callback(MQTT_msg_received_callback cb) {
    on_msg_callback = cb;
}

/** Process incoming MQTT data and keep the connection alive*/
int app_mqtt_process(struct mqtt_client *client)
{
	int rc;

	rc = poll_mqtt_socket(client, mqtt_keepalive_time_left(client));
	if (rc != 0) {
		if (fds[0].revents & POLLIN) {
			/* MQTT data received */
			rc = mqtt_input(client);
			if (rc != 0) {
				LOG_ERR("MQTT Input failed [%d]", rc);
				return rc;
			}
			/* Socket error */
			if (fds[0].revents & (POLLHUP | POLLERR)) {
				LOG_ERR("MQTT socket closed / error");
				return -ENOTCONN;
			}
		}
	} else {
		/* Socket poll timed out, time to call mqtt_live() */
		rc = mqtt_live(client);
		if (rc != 0) {
			LOG_ERR("MQTT Live failed [%d]", rc);
			return rc;
		}
	}

	return 0;
}

void app_mqtt_run(struct mqtt_client *client)
{
	int rc;

	/* Subscribe to MQTT topics */
	app_mqtt_subscribe(client);

	/* Thread will primarily remain in this loop */
	while (mqtt_connected) {
		rc = app_mqtt_process(client);
		if (rc != 0) {
			break;
		}
	}
	/* Gracefully close connection */
	mqtt_disconnect(client, NULL);
}

void app_mqtt_connect(struct mqtt_client *client)
{
	int rc = 0;

	mqtt_connected = false;

	/* Block until MQTT CONNACK event callback occurs */
	while (!mqtt_connected) {
		rc = mqtt_connect(client);
		if (rc != 0) {
			LOG_ERR("MQTT Connect failed [%d]", rc);
			k_msleep(MSECS_WAIT_RECONNECT);
			continue;
		}

		/* Poll MQTT socket for response */
		rc = poll_mqtt_socket(client, MSECS_NET_POLL_TIMEOUT);
		if (rc > 0) {
			mqtt_input(client);
		}

		if (!mqtt_connected) {
			mqtt_abort(client);
		}
	}
}

int app_mqtt_init(struct mqtt_client *client)
{
	int rc;
	uint8_t broker_ip[NET_IPV4_ADDR_LEN];
	struct sockaddr_in *broker4;
	struct addrinfo *result;
	const struct addrinfo hints = {
		.ai_family = AF_INET,
		.ai_socktype = SOCK_STREAM
	};

	/* Resolve IP address of MQTT broker */
	rc = getaddrinfo(CONFIG_NET_SAMPLE_MQTT_BROKER_HOSTNAME,
				CONFIG_NET_SAMPLE_MQTT_BROKER_PORT, &hints, &result);
	if (rc != 0) {
		LOG_ERR("Failed to resolve broker hostname [%s]", gai_strerror(rc));
		return -EIO;
	}
	if (result == NULL) {
		LOG_ERR("Broker address not found");
		return -ENOENT;
	}

	broker4 = (struct sockaddr_in *)&broker;
	broker4->sin_addr.s_addr = ((struct sockaddr_in *)result->ai_addr)->sin_addr.s_addr;
	broker4->sin_family = AF_INET;
	broker4->sin_port = ((struct sockaddr_in *)result->ai_addr)->sin_port;
	freeaddrinfo(result);

	/* Log resolved IP address */
	inet_ntop(AF_INET, &broker4->sin_addr.s_addr, broker_ip, sizeof(broker_ip));
	LOG_INF("Connecting to MQTT broker @ %s", broker_ip);

	/* MQTT client configuration */
	init_mqtt_client_id();
	mqtt_client_init(client);
	client->broker = &broker;
	client->evt_cb = mqtt_event_handler;
	client->client_id.utf8 = client_id;
	client->client_id.size = strlen(client->client_id.utf8);
	client->password = NULL;
	client->user_name = NULL;
	client->protocol_version = MQTT_VERSION_3_1_1;

	/* MQTT buffers configuration */
	client->rx_buf = rx_buffer;
	client->rx_buf_size = sizeof(rx_buffer);
	client->tx_buf = tx_buffer;
	client->tx_buf_size = sizeof(tx_buffer);

	/* MQTT transport configuration */
#if defined(CONFIG_MQTT_LIB_TLS)
	struct mqtt_sec_config *tls_config;

	client->transport.type = MQTT_TRANSPORT_SECURE;

	rc = tls_init();
	if (rc != 0) {
		LOG_ERR("TLS init error");
		return rc;
	}

	tls_config = &client->transport.tls.config;
	tls_config->peer_verify = TLS_PEER_VERIFY_REQUIRED;
	tls_config->cipher_list = NULL;
	tls_config->sec_tag_list = m_sec_tags;
	tls_config->sec_tag_count = ARRAY_SIZE(m_sec_tags);
#if defined(CONFIG_MBEDTLS_SSL_SERVER_NAME_INDICATION)
	tls_config->hostname = TLS_SNI_HOSTNAME;
#else
	tls_config->hostname = NULL;
#endif /* CONFIG_MBEDTLS_SSL_SERVER_NAME_INDICATION */
#endif /* CONFIG_MQTT_LIB_TLS */

	return rc;
}
```

## src/mqtt_client.h
```c
/**
 * @file mqtt_client.h
 * @brief MQTT client interface for initializing, connecting, subscribing, and publishing.
 *
 * @copyright Copyright (c) 2024 Analog Devices, Inc.
 * @author Modified by Renan Augusto Starke, 2026.
 * @license SPDX-License-Identifier: Apache-2.0
 */

#ifndef __MQTT_CLIENT_H__
#define __MQTT_CLIENT_H__

/** MQTT connection timeouts */
#define MSECS_NET_POLL_TIMEOUT	5000
#define MSECS_WAIT_RECONNECT	1000


/**
 * @brief Global MQTT connection status flag.
 *
 * Indicates whether the client is currently connected to the MQTT broker (`true`)
 * or disconnected (`false`).
 */
extern bool mqtt_connected;

/**
 *  @brief Initialise the MQTT client & broker configuration
 */
int app_mqtt_init(struct mqtt_client *client);

/**
 *  @brief Blocking function that establishes connectivity to the MQTT broker
 */
void app_mqtt_connect(struct mqtt_client *client);

/**
 *  @brief  Subscribes to user-defined MQTT topics and continuously
 *          processes incoming data while the MQTT connection is active
 */
void app_mqtt_run(struct mqtt_client *client);

/**
 *  @brief   Subscribe to user-defined MQTT topics
 */
int app_mqtt_subscribe(struct mqtt_client *client);

/**
 * @brief Publish an MQTT payload to a specified topic.
 *
 * @param[in,out] client       Pointer to a connected @c mqtt_client instance.
 * @param[in]     topic        Null-terminated string specifying the target MQTT topic.
 * @param[in]     payload_data Pointer to the data buffer to be published.
 *
 * @return 0 on success, or a negative error code on failure.
 */
int app_mqtt_publish(struct mqtt_client *client, const char *topic, uint8_t *payload_data);

/**
 * @brief Callback function pointer type for received MQTT messages.
 *
 * @param[in] topic        Null-terminated string containing the topic name on which
 *                         the message was received.
 * @param[in] payload_data Pointer to the received message payload buffer.
 */
typedef void (*MQTT_msg_received_callback)(const char *topic, uint8_t *payload_data);

/**
 * @brief Register a callback function for incoming MQTT messages.
 *
 * Sets the user-defined handler that will be invoked whenever a message is received
 * on a subscribed topic.
 *
 * @param[in] cb Function pointer matching the @ref MQTT_msg_received_callback signature.
 */
void register_MQTT_sub_callback(MQTT_msg_received_callback cb);


#endif /* __MQTT_CLIENT_H__ */
```

## src/wifi.c
```c
/**
 * @file wifi.c
 * @brief Wi-Fi initialization and connection management using Zephyr's network management API.
 *
 * Configures static Wi-Fi credentials, registers Layer 4 (L4) network event callbacks,
 * and handles blocking connection establishment until network connectivity is achieved.
 */

/* C includes */
#include <errno.h>
#include <stddef.h>
#include <string.h>
#include <stdio.h>

/* Zephyr includes */
#include <zephyr/kernel.h>
#include <zephyr/types.h>
#include <zephyr/logging/log.h>

/* Wifi header files */
#include <zephyr/net/net_mgmt.h>
#include <zephyr/net/wifi_mgmt.h>
#include <zephyr/net/wifi_credentials.h>

/** @brief Register the Wi-Fi logging module with INFO log level. */
LOG_MODULE_REGISTER(wifi, LOG_LEVEL_INF);


/**
 * @brief Macro defining the relevant network events to listen for.
 *
 * Mask includes Layer 4 (L4) connected and disconnected events.
 */
#define EVENT_MASK (NET_EVENT_L4_CONNECTED | NET_EVENT_L4_DISCONNECTED)

/**
 * @brief Callback structure for network management events.
 */
static struct net_mgmt_event_callback mgmt_cb;

/* Declare the variable for the network configuration parameters */
static struct wifi_connect_req_params cnx_params;

/**
 * @brief Flag indicating the current Wi-Fi connection status.
 *
 * True if connected to the network, false otherwise.
 */
static bool connected;

/**
 * @brief Semaphore used to block the application until a network connection is established.
 */
static K_SEM_DEFINE(run_app, 0, 1);

/**
 * @brief Callback handler for network management events.
 *
 * @details Handles Layer 4 (L4) connection and disconnection events. It updates
 * the `connected` flag and signals the `run_app` semaphore upon a successful
 * connection, or resets the semaphore upon disconnection.
 *
 * @param cb Pointer to the network management event callback structure.
 * @param mgmt_event The specific network management event that triggered the callback.
 * @param iface Pointer to the network interface where the event occurred.
 */
static void net_mgmt_event_handler(struct net_mgmt_event_callback *cb,
			  uint64_t mgmt_event, struct net_if *iface)
{	
	if ((mgmt_event & EVENT_MASK) != mgmt_event) {
		return;
	}

	if (mgmt_event == NET_EVENT_L4_CONNECTED) {
		LOG_INF("Network connected");
		connected = true;
		k_sem_give(&run_app);
		return;
	}
	if (mgmt_event == NET_EVENT_L4_DISCONNECTED) {
		if (connected == false) {
			LOG_INF("Waiting for network to be connected");
		} else {
			LOG_INF("Network disconnected");
			connected = false;
		}
		k_sem_reset(&run_app);
		return;
	}
}


/**
 * @brief Populates the Wi-Fi connection request parameters.
 *
 * @details Extracts the SSID and password from the Zephyr Kconfig definitions
 * (`CONFIG_WIFI_CREDENTIALS_STATIC_SSID` and `CONFIG_WIFI_CREDENTIALS_STATIC_PASSWORD`)
 * and populates the remaining connection parameters with generic defaults.
 *
 * @param params Pointer to the Wi-Fi connection request parameters structure to populate.
 * @return int Returns 0 on successful population.
 */
static int write_wifi_parameters(struct wifi_connect_req_params *params)
{

	/* Populate the SSID and password from prj.conf */
	params->ssid = CONFIG_WIFI_CREDENTIALS_STATIC_SSID;
	params->ssid_length = strlen(params->ssid);

	params->psk = CONFIG_WIFI_CREDENTIALS_STATIC_PASSWORD;
	params->psk_length = strlen(params->psk);

	/* Populate the rest of the relevant members */
	params->channel = WIFI_CHANNEL_ANY;
	params->security = WIFI_SECURITY_TYPE_PSK;
	params->mfp = WIFI_MFP_OPTIONAL;
	params->timeout = SYS_FOREVER_MS;
	params->band = WIFI_FREQ_BAND_UNKNOWN;
	memset(params->bssid, 0, sizeof(params->bssid));

	return 0;
}

/**
 * @brief Initializes the Wi-Fi driver and attempts connection.
 *
 * @details Sets up the necessary callbacks for monitoring Wi-Fi status, retrieves
 * the default Wi-Fi network interface, provisions it with static credentials, and
 * dispatches connection requests via `net_mgmt()`. The function polls every 5 seconds
 * if the connection fails and will ultimately block indefinitely until `run_app` is given.
 *
 * @return int Returns -1 if no Wi-Fi interface is found. Otherwise, blocks until connection.
 */
int setup_wifi(){

	LOG_INF("Initializing Wi-Fi driver");
	/* Sleep to allow initialization of Wi-Fi driver */
	k_sleep(K_SECONDS(1));

	/* Initialize and add the callback function for network events */
	net_mgmt_init_event_callback(&mgmt_cb, net_mgmt_event_handler, EVENT_MASK);
	net_mgmt_add_event_callback(&mgmt_cb);

	/* Get the network interface */
	struct net_if *iface = net_if_get_first_wifi();
	if (iface == NULL) {
		LOG_ERR("Returned network interface is NULL");
		return -1;
	}

	/* Populate cnx_params with the network configuration */
	write_wifi_parameters(&cnx_params);

	/* Call net_mgmt() to request the Wi-Fi connection */
	int err;

	/* Try to connect */
	do {
		LOG_INF("Connecting to WiFi...");
		err = net_mgmt(NET_REQUEST_WIFI_CONNECT, iface, &cnx_params, sizeof(struct wifi_connect_req_params));

		if (err) {
			LOG_ERR("Connecting to Wi-Fi failed, err: %d", err);
			LOG_ERR("New try in 5s.");
			k_sleep(K_SECONDS(5));
		}
	} while (err != 0);

	LOG_INF("Waiting to connect!");

	/* Wait forever for a wifi connection.
	 * Unblocked by the callback funcion */
	k_sem_take(&run_app, K_FOREVER);

	return 0;
}
```

## src/wifi.h
```c
#ifndef __WIFI_H__
#define __WIFI_H__


int setup_wifi();


#endif
```
